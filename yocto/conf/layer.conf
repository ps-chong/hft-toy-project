## yocto/conf/machine/hft-zcu102.conf
```bitbake
#@TYPE: Machine
#@NAME: HFT ZCU102
#@DESCRIPTION: ZCU102 A53 Linux plus R5-0 FreeRTOS reference configuration

require conf/machine/zynqmp-zcu102-sdt-full.conf

MACHINEOVERRIDES =. "hft-zcu102:"
MACHINE_FEATURES:append = " openamp fpga-overlay"
BBMULTICONFIG += "hft-zcu102-cortexr5-0-freertos"

KERNEL_DEVICETREE:append = " hft-zcu102-overlay.dtbo"
IMAGE_FSTYPES:append = " wic wic.bmap"
WKS_FILE = "hft-zcu102-ab.wks.in"

HFT_R5_FIRMWARE ?= "hft-r5.elf"
HFT_PL_BITSTREAM ?= "zcu102_hft.bit"

UBOOT_ENV:append = " boot_slot upgrade_available bootcount bootlimit"
KERNEL_MODULE_AUTOLOAD:append = " zynqmp_r5_remoteproc rpmsg_char"
```
